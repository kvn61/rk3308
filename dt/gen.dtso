/dts-v1/;
/plugin/;

&{/} {
//    gen22m: gen22m {
    mclk_i2s0_8ch_in: mclk_i2s0_8ch_in {
	compatible = "fixed-clock";
	#clock-cells = <0>;
	clock-frequency = <22579200>;
	status = "okay";
	clock-output-names = "mclk_i2s0_8ch_in";
    };

#if 0
    gen24m: gen24m {
	compatible = "fixed-clock";
	#clock-cells = <0>;
	clock-frequency = <24576000>;
	status = "okay";
    };

//    mclk_i2s0_2ch_in: mclk_i2s0_2ch_in  {
    mclk_i2s0_8ch_in: mclk_i2s0_8ch_in {
	compatible = "gpio-mux-clock";
	#clock-cells = <0>;
	clocks = <&gen22m>, <&gen24m>;
// uart0_cts
////	select-gpios = <&gpio2 RK_PA2 GPIO_ACTIVE_HIGH>;
// SPDIF_TX
	select-gpios = <&gpio0 RK_PC1 GPIO_ACTIVE_LOW>;
	status = "okay";
    };
#endif
};

&cru {
//	assigned-clocks = <&cru SCLK_I2S0_8CH_TX_OUT>;
//	assigned-clock-parents = <&cru SCLK_I2S0_8CH_TX>;
//	assigned-clocks = <&cru SCLK_I2S0_8CH_TX_MUX>;
//	, <&cru SCLK_I2S0_8CH_RX_MUX>;
//	assigned-clock-parents = <&osc33m>, <&osc33m>;
//	assigned-clock-parents = <&mclk_i2s0_8ch_in>;
//	, <&mclk_i2s0_8ch_in>;
//	assigned-clock-rates = <45158400>;
//	, <45158400>;
//	assigned-clock-rates = <33868800>;
//	, <33868800>;
};
