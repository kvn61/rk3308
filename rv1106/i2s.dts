    clk_44: clk_44 {
	compatible = "fixed-clock";
	#clock-cells = <0>;
    	status = "okay";
// проверить
    	clock-frequency = <22579200>;
    };

    clk_48: clk_48 {
      	compatible = "fixed-clock";
      	#clock-cells = <0>;
      	status = "okay";
// проверить
      	clock-frequency = <24576000>;
    };

    i2s0_mclkin: i2s0_mclkin {
      	compatible = "gpio-mux-clock";
      	#clock-cells = <0>;
      	clocks = <&clk_44>, <&clk_48>;
      	clock-output-names = "i2s0_mclkin";
      	status = "okay";
// проверить
	select-gpios = <&gpio0 RK_PC1 GPIO_ACTIVE_HIGH>;
    };


...I2S... {
	...

	clocks = <&cru MCLK_I2S0_8CH_TX>, <&cru MCLK_I2S0_8CH_RX>, <&cru HCLK_I2S0>, <&i2s0_mclkin>, <&clk_44>, <&clk_48>;
	clock-names = "mclk_tx", "mclk_rx", "hclk", "mclk_ext", "clk_44", "clk_48";
	assigned-clocks = <&cru CLK_I2S0_8CH_TX>, <&cru CLK_I2S0_8CH_RX>;
	assigned-clock-parents = <&i2s0_mclkin>, <&i2s0_mclkin>;
	my,mclk_external;

	...
};

...CARD... {
	compatible = "simple-audio-card";
	simple-audio-card,name = "...";
	
	simple-audio-card,format = "...";
	
	simple-audio-card,bitclock-master = <&card_master>;
	simple-audio-card,frame-master = <&card_master>;

	card_master: simple-audio-card,cpu {
		sound-dai = <...>;
	};

	simple-audio-card,codec {
		sound-dai = <...>;
	};
};
